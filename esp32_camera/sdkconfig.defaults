## esp32_camera/sdkconfig.defaults
```kconfig
CONFIG_SPIRAM=y
CONFIG_SPIRAM_MODE_OCT=y
CONFIG_SPIRAM_TYPE_ESPPSRAM64=y
CONFIG_SPIRAM_SPEED_80M=y
CONFIG_LIBC_STDOUT_LINE_ENDING_LF=y
CONFIG_NEWLIB_STDOUT_LINE_ENDING_LF=y
```
